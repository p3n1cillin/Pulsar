## firmware/airsoft-scope/main/Kconfig.projbuild
```kconfig
menu "Airsoft scope configuration"

choice AIRSOFT_SCOPE_MODE
    prompt "Operating mode"
    default AIRSOFT_SCOPE_MODE_SIMULATION

config AIRSOFT_SCOPE_MODE_SIMULATION
    bool "Simulation (no radar hardware)"
    help
        Generate synthetic radar targets for development on a bare ESP32-S3.

config AIRSOFT_SCOPE_MODE_LIVE
    bool "Live LD2450 radar"
    help
        Read target reports from a connected HLK-LD2450 over UART.

endchoice

config AIRSOFT_LD2450_UART_NUM
    int "LD2450 UART port"
    range 0 2
    default 1

config AIRSOFT_LD2450_TX_GPIO
    int "LD2450 TX GPIO (ESP32 -> radar RX)"
    range 0 48
    default 1 if AIRSOFT_CAMERA_BOARD_S3_CAM
    default 18

config AIRSOFT_LD2450_RX_GPIO
    int "LD2450 RX GPIO (radar TX -> ESP32)"
    range 0 48
    default 14 if AIRSOFT_CAMERA_BOARD_S3_CAM
    default 17

config AIRSOFT_LD2450_BAUD
    int "LD2450 UART baud rate"
    default 256000

config AIRSOFT_DISPLAY_WIDTH
    int "Display width (pixels)"
    default 320

config AIRSOFT_DISPLAY_HEIGHT
    int "Display height (pixels)"
    default 240

choice AIRSOFT_DISPLAY_ROTATION
    prompt "Display rotation"
    default AIRSOFT_DISPLAY_ROTATION_0
    help
        Rotate the rendered image to match how the unit is mounted in its
        housing. 0/180 keep the native 320x240 landscape; 90/270 produce a
        240x320 portrait image (rotated in software).

config AIRSOFT_DISPLAY_ROTATION_0
    bool "0 deg (landscape)"

config AIRSOFT_DISPLAY_ROTATION_90
    bool "90 deg (portrait)"

config AIRSOFT_DISPLAY_ROTATION_180
    bool "180 deg (landscape, flipped)"

config AIRSOFT_DISPLAY_ROTATION_270
    bool "270 deg (portrait, flipped)"

endchoice

config AIRSOFT_CAMERA_HFOV_DEG
    int "Camera horizontal field of view (degrees)"
    range 30 120
    default 66
    help
        Used to map radar bearings onto the camera overlay. Calibrate in the field.

config AIRSOFT_RADAR_HFOV_DEG
    int "Radar horizontal field of view (degrees)"
    range 30 120
    default 90
    help
        LD2450 usable horizontal field used to reject side-lobe contacts.

config AIRSOFT_RADAR_BORESIGHT_OFFSET_DEG
    int "Radar-to-camera horizontal offset (degrees)"
    range -30 30
    default 0
    help
        Calibration offset added to radar bearings before camera association.
        Positive values move radar tracks to the right in the camera image.

config AIRSOFT_MAX_RANGE_M
    int "Maximum overlay range (metres)"
    range 1 12
    default 8

config AIRSOFT_SERIAL_PREVIEW
    bool "Print ASCII overlay preview on USB serial"
    default y

config AIRSOFT_SERIAL_PREVIEW_PERIOD_MS
    int "Serial preview period (ms)"
    depends on AIRSOFT_SERIAL_PREVIEW
    range 250 10000
    default 1000
    help
        Rate limit the multi-line ASCII preview to avoid serial logging from
        consuming the render task's frame budget.

choice AIRSOFT_CAMERA_BOARD
    prompt "Camera board"
    default AIRSOFT_CAMERA_BOARD_NONE

config AIRSOFT_CAMERA_BOARD_NONE
    bool "No camera (radar + serial preview only)"
    help
        Use until an ESP32-S3-CAM board is wired. Radar overlay math still runs.

config AIRSOFT_CAMERA_BOARD_S3_CAM
    bool "ESP32-S3-CAM (Freenove / OV2640 DVP preset)"
    help
        Enables live OV2640 capture and composites radar blips on each frame.

endchoice

config AIRSOFT_CAMERA_MOTION_TRACKING
    bool "Track moving camera regions"
    depends on AIRSOFT_CAMERA_BOARD_S3_CAM
    default y
    help
        Run a low-memory visual motion detector. It contributes bearing-only
        observations that are associated with persistent radar tracks.

config AIRSOFT_CAMERA_MOTION_THRESHOLD
    int "Camera motion sensitivity threshold"
    depends on AIRSOFT_CAMERA_MOTION_TRACKING
    range 5 80
    default 18
    help
        Minimum exposure-compensated luma change (0-255) in a downsampled
        camera cell. Lower values see subtler motion but produce more noise.

config AIRSOFT_CAMERA_MIN_MOTION_CELLS
    int "Minimum moving cells per visual target"
    depends on AIRSOFT_CAMERA_MOTION_TRACKING
    range 2 50
    default 4

config AIRSOFT_CAMERA_GLOBAL_MOTION_PERCENT
    int "Suppress frame when motion exceeds (percent)"
    depends on AIRSOFT_CAMERA_MOTION_TRACKING
    range 10 90
    default 45
    help
        Prevents panning or shaking the scope from creating false tracks.

config AIRSOFT_DEBUG_WIFI_STREAM
    bool "Enable Wi-Fi debug camera stream"
    default n
    help
        Join a 2.4 GHz network and serve the current display frame as JPEG
        (GET /jpg) and MJPEG (GET /stream). For bench debugging only.

config AIRSOFT_WIFI_SSID
    string "Wi-Fi SSID (2.4 GHz)"
    depends on AIRSOFT_DEBUG_WIFI_STREAM
    default ""

config AIRSOFT_WIFI_PASS
    string "Wi-Fi password"
    depends on AIRSOFT_DEBUG_WIFI_STREAM
    default ""

config AIRSOFT_STREAM_TOKEN
    string "Debug stream bearer token"
    depends on AIRSOFT_DEBUG_WIFI_STREAM
    default ""
    help
        Required value for the HTTP Authorization header as "Bearer TOKEN".
        The stream refuses to start when this token is empty. Keep the generated
        sdkconfig local; it is excluded from version control.

config AIRSOFT_MIN_RANGE_M
    int "Ignore radar contacts closer than (cm)"
    range 50 300
    default 120
    help
        Suppresses self-clutter and muzzle-adjacent noise. Value is centimetres.

config AIRSOFT_TRACK_RADAR_GATE_CM
    int "Radar track association gate (cm)"
    range 30 300
    default 120
    help
        Maximum predicted-to-measured distance for keeping the same track ID.

config AIRSOFT_TRACK_CAMERA_GATE_DEG
    int "Camera/radar association gate (degrees)"
    range 3 30
    default 12
    help
        Maximum bearing difference for treating visual and radar observations
        as the same player.

config AIRSOFT_TRACK_RADAR_HOLD_MS
    int "Radar source hold time (ms)"
    range 100 2000
    default 500

config AIRSOFT_TRACK_CAMERA_HOLD_MS
    int "Camera source hold time (ms)"
    range 100 2000
    default 400

config AIRSOFT_TRACK_COAST_MS
    int "Track prediction timeout (ms)"
    range 300 5000
    default 1600
    help
        Keep predicting a player briefly when both sensors lose them. Longer
        values bridge occlusion better but retain stale contacts for longer.

endmenu
```

## firmware/airsoft-scope/sdkconfig.defaults
```kconfig
CONFIG_IDF_TARGET="esp32s3"
CONFIG_ESP32S3_SPIRAM_SUPPORT=y
CONFIG_SPIRAM=y
CONFIG_SPIRAM_MODE_OCT=y
CONFIG_SPIRAM_SPEED_80M=y
CONFIG_FREERTOS_HZ=1000
CONFIG_COMPILER_OPTIMIZATION_PERF=y
CONFIG_ESP_MAIN_TASK_STACK_SIZE=8192
```
