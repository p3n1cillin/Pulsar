## firmware/airsoft-scope/main/Kconfig.projbuild
```kconfig
menu "Airsoft scope configuration"

choice AIRSOFT_SCOPE_MODE
    prompt "Operating mode"
    default AIRSOFT_SCOPE_MODE_SIMULATION

config AIRSOFT_SCOPE_MODE_SIMULATION
    bool "Simulation (no radar hardware)"
    help
        Generate synthetic radar targets for development on a bare ESP32-S3.

config AIRSOFT_SCOPE_MODE_LIVE
    bool "Live LD2450 radar"
    help
        Read target reports from a connected HLK-LD2450 over UART.

endchoice

config AIRSOFT_LD2450_UART_NUM
    int "LD2450 UART port"
    range 0 2
    default 1

config AIRSOFT_LD2450_TX_GPIO
    int "LD2450 TX GPIO (ESP32 -> radar RX)"
    range 0 48
    default 1 if AIRSOFT_CAMERA_BOARD_S3_CAM
    default 18

config AIRSOFT_LD2450_RX_GPIO
    int "LD2450 RX GPIO (radar TX -> ESP32)"
    range 0 48
    default 14 if AIRSOFT_CAMERA_BOARD_S3_CAM
    default 17

config AIRSOFT_LD2450_BAUD
    int "LD2450 UART baud rate"
    default 256000

config AIRSOFT_DISPLAY_WIDTH
    int "Display width (pixels)"
    default 320

config AIRSOFT_DISPLAY_HEIGHT
    int "Display height (pixels)"
    default 240

choice AIRSOFT_DISPLAY_ROTATION
    prompt "Display rotation"
    default AIRSOFT_DISPLAY_ROTATION_0
    help
        Rotate the rendered image to match how the unit is mounted in its
        housing. 0/180 keep the native 320x240 landscape; 90/270 produce a
        240x320 portrait image (rotated in software).

config AIRSOFT_DISPLAY_ROTATION_0
    bool "0 deg (landscape)"

config AIRSOFT_DISPLAY_ROTATION_90
    bool "90 deg (portrait)"

config AIRSOFT_DISPLAY_ROTATION_180
    bool "180 deg (landscape, flipped)"

config AIRSOFT_DISPLAY_ROTATION_270
    bool "270 deg (portrait, flipped)"

endchoice

config AIRSOFT_CAMERA_HFOV_DEG
    int "Camera horizontal field of view (degrees)"
    range 30 120
    default 66
    help
        Used to map radar bearings onto the camera overlay. Calibrate in the field.

config AIRSOFT_RADAR_HFOV_DEG
    int "Radar horizontal field of view (degrees)"
    range 30 120
    default 90
    help
        LD2450 usable horizontal field used to reject side-lobe contacts.

config AIRSOFT_RADAR_BORESIGHT_OFFSET_DEG
    int "Radar-to-camera horizontal offset (degrees)"
    range -30 30
    default 0
    help
        Calibration offset added to radar bearings before camera association.
        Positive values move radar tracks to the right in the camera image.

config AIRSOFT_MAX_RANGE_M
    int "Maximum overlay range (metres)"
    range 1 12
    default 8

config AIRSOFT_SERIAL_PREVIEW
    bool "Print ASCII overlay preview on USB serial"
    default y

config AIRSOFT_SERIAL_PREVIEW_PERIOD_MS
    int "Serial preview period (ms)"
    depends on AIRSOFT_SERIAL_PREVIEW
    range 250 10000
    default 1000
    help
        Rate limit the multi-line ASCII preview to avoid serial logging from
        consuming the render task's frame budget.

choice AIRSOFT_CAMERA_BOARD
    prompt "Camera board"
    default AIRSOFT_CAMERA_BOARD_NONE

config AIRSOFT_CAMERA_BOARD_NONE
    bool "No camera (radar + serial preview only)"
    help
        Use until an ESP32-S3-CAM board is wired. Radar overlay math still runs.

config AIRSOFT_CAMERA_BOARD_S3_CAM
    bool "ESP32-S3-CAM (Freenove / OV2640 DVP preset)"
    help
        Enables live OV2640 capture and composites radar blips on each frame.

endchoice

config AIRSOFT_CAMERA_HMIRROR
    bool "Mirror camera image horizontally"
    depends on AIRSOFT_CAMERA_BOARD_S3_CAM
    default y
    help
        Match the image to the operator's left/right. Toggle if contacts and
        the scene move in opposite directions when you pan the scope.

config AIRSOFT_CAMERA_VFLIP
    bool "Flip camera image vertically"
    depends on AIRSOFT_CAMERA_BOARD_S3_CAM
    default y
    help
        Toggle if the live feed is upside down for your camera mounting.

config AIRSOFT_CAMERA_MOTION_TRACKING
    bool "Track moving camera regions"
    depends on AIRSOFT_CAMERA_BOARD_S3_CAM
    default y
    help
        Run a low-memory visual motion detector. It contributes bearing-only
        observations that are associated with persistent radar tracks.

config AIRSOFT_CAMERA_MOTION_THRESHOLD
    int "Camera motion sensitivity threshold"
    depends on AIRSOFT_CAMERA_MOTION_TRACKING
    range 5 80
    default 18
    help
        Minimum exposure-compensated luma change (0-255) in a downsampled
        camera cell. Lower values see subtler motion but produce more noise.

config AIRSOFT_CAMERA_MIN_MOTION_CELLS
    int "Minimum moving cells per visual target"
    depends on AIRSOFT_CAMERA_MOTION_TRACKING
    range 2 50
    default 4

config AIRSOFT_CAMERA_GLOBAL_MOTION_PERCENT
    int "Suppress frame when motion exceeds (percent)"
    depends on AIRSOFT_CAMERA_MOTION_TRACKING
    range 10 90
    default 45
    help
        Prevents panning or shaking the scope from creating false tracks.

config AIRSOFT_DEBUG_WIFI_STREAM
    bool "Enable Wi-Fi debug camera stream"
    default n
    help
        Join a 2.4 GHz network and serve the current display frame as JPEG
        (GET /jpg) and MJPEG (GET /stream). For bench debugging only.

config AIRSOFT_WIFI_SSID
    string "Wi-Fi SSID (2.4 GHz)"
    depends on AIRSOFT_DEBUG_WIFI_STREAM
    default ""

config AIRSOFT_WIFI_PASS
    string "Wi-Fi password"
    depends on AIRSOFT_DEBUG_WIFI_STREAM
    default ""

config AIRSOFT_STREAM_TOKEN
    string "Debug stream bearer token"
    depends on AIRSOFT_DEBUG_WIFI_STREAM
    default ""
    help
        Required value for the HTTP Authorization header as "Bearer TOKEN".
        The stream refuses to start when this token is empty. Keep the generated
        sdkconfig local; it is excluded from version control.

config AIRSOFT_RADAR_LINK_TIMEOUT_MS
    int "Radar link timeout (ms)"
    depends on AIRSOFT_SCOPE_MODE_LIVE
    range 300 5000
    default 1000
    help
        Show a "NO RADAR" warning when no LD2450 frame arrives for this long.
        The module streams ~10 frames/s even with no targets, so silence means
        a wiring, power, or baud-rate fault rather than an empty room.

config AIRSOFT_CONTROLS
    bool "Housing buttons (brightness, declutter, boresight calibration)"
    default y
    help
        Two momentary buttons to GND with internal pull-ups. Safe to leave
        enabled with no buttons fitted: idle pins read as released.

config AIRSOFT_BUTTON_MODE_GPIO
    int "MODE button GPIO (A)"
    depends on AIRSOFT_CONTROLS
    range 0 48
    default 21

config AIRSOFT_BUTTON_ADJUST_GPIO
    int "ADJUST button GPIO (B)"
    depends on AIRSOFT_CONTROLS
    range 0 48
    default 47

config AIRSOFT_BUTTON_LONG_PRESS_MS
    int "Long-press threshold (ms)"
    depends on AIRSOFT_CONTROLS
    range 400 3000
    default 900

config AIRSOFT_BATTERY_SENSE
    bool "Battery voltage monitor"
    default n
    help
        Read the 1S Li-ion cell through a resistor divider on an ADC1 pin and
        show a battery gauge on the HUD. Needs the divider fitted.

config AIRSOFT_BATTERY_ADC_GPIO
    int "Battery sense GPIO (ADC1 only)"
    depends on AIRSOFT_BATTERY_SENSE
    range 1 10
    default 3
    help
        GPIO3 is the only free ADC1 pin on the Freenove S3-CAM build (GPIO1 is
        the radar UART, GPIO2 the backlight, 4-10 the camera).

config AIRSOFT_BATTERY_DIVIDER_X100
    int "Battery divider ratio x100"
    depends on AIRSOFT_BATTERY_SENSE
    range 100 1000
    default 200
    help
        Cell voltage / pin voltage, times 100. 200 = two equal resistors
        (e.g. 100k / 100k).

config AIRSOFT_MIN_RANGE_M
    int "Ignore radar contacts closer than (cm)"
    range 50 300
    default 120
    help
        Suppresses self-clutter and muzzle-adjacent noise. Value is centimetres.

config AIRSOFT_TRACK_RADAR_GATE_CM
    int "Radar track association gate (cm)"
    range 30 300
    default 120
    help
        Maximum predicted-to-measured distance for keeping the same track ID.

config AIRSOFT_TRACK_CAMERA_GATE_DEG
    int "Camera/radar association gate (degrees)"
    range 3 30
    default 12
    help
        Maximum bearing difference for treating visual and radar observations
        as the same player.

config AIRSOFT_TRACK_RADAR_HOLD_MS
    int "Radar source hold time (ms)"
    range 100 2000
    default 500

config AIRSOFT_TRACK_CAMERA_HOLD_MS
    int "Camera source hold time (ms)"
    range 100 2000
    default 400

config AIRSOFT_TRACK_COAST_MS
    int "Track prediction timeout (ms)"
    range 300 5000
    default 1600
    help
        Keep predicting a player briefly when both sensors lose them. Longer
        values bridge occlusion better but retain stale contacts for longer.

endmenu
```
